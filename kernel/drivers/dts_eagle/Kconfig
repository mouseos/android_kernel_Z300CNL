## kernel/drivers/dts_eagle/Kconfig
```kconfig
config DTS_EAGLE
	tristate "DTS Eagle driver"
	depends on X86
	default y if X86
	help
	  DTS Eagle module.
```

## kernel/drivers/input/touchscreen/ft5826s/Kconfig
```kconfig
config TOUCHSCREEN_FOCAL_FT5826S
	tristate "FOCAL FT5826S touchscreen"
	depends on I2C
	default n
	help
		Say Y here if you have a FOCAL FT5826 touchscreen
		If unsure, say N.
```

## kernel/drivers/input/touchscreen/gt9271/Kconfig
```kconfig
config TOUCHSCREEN_GOODIX_GT9271
	tristate "Goodix GT928 touchscreen"
	depends on I2C
	default y
	help
		Say Y here if you have a Goodix GT928 touchscreen
		If unsure, say N.
```

## modules/camera/drivers/media/i2c/ov5670/Kconfig
```kconfig
#
# Kconfig for sensor drivers
#
config VIDEO_OV5670
       tristate "OVT ov5670 sensor support"
       depends on I2C && VIDEO_V4L2
       ---help---
         This is a Video4Linux2 sensor-level driver for the OVT
         OV5670 5M camera.


         It currently only works with the atomisp driver.
```
